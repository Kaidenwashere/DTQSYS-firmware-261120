## boards/nordic/promicro_uf2/promicro_uf2_dtqsys_defconfig
```kconfig
# DTQSYS nRF52840, ICM45686 SPI + QMC6309 I2C
CONFIG_ARM_MPU=y
CONFIG_HW_STACK_PROTECTION=y
CONFIG_SLIMEVR_USB_DEVICE_MANUFACTURER="SlimeVR"
CONFIG_SLIMEVR_USB_DEVICE_PRODUCT="SlimeNRF DTQSYS Tracker"
CONFIG_BATTERY_USE_REG_LDO_MAPPING=y
CONFIG_SENSOR_ROTATION_270=y
CONFIG_SENSOR_IMU_DRIVERS_MINIMAL=y
CONFIG_SENSOR_DRV_ICM45686=y
CONFIG_SENSOR_MAG_DRIVERS_MINIMAL=y
CONFIG_SENSOR_DRV_QMC6309=y
CONFIG_BUILD_OUTPUT_UF2=y
CONFIG_BUILD_OUTPUT_UF2_FAMILY_ID="0xADA52840"
```
